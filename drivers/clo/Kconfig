## drivers/clo/Kconfig
```kconfig
#
# CLO (Cross-layer Optimizer For Mobile Network configuration
#
config CLO
	tristate "CLO configuration"
	default n
	help
		Optimization Solutions for Mobile Networks
```
